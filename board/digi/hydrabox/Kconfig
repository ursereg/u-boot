## board/digi/hydrabox/Kconfig
```kconfig
if TARGET_hydrabox

config MCA
	bool
	default y

config SYS_BOARD
	default "hydrabox"

config SYS_VENDOR
	default "digi"

config SYS_SOC
	default "mx6"

config SYS_CONFIG_NAME
	default "hydrabox"

endif
```
